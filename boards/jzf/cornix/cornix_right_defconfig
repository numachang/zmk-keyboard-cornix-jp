## boards/jzf/cornix/cornix_right_defconfig
```kconfig
# SPDX-License-Identifier: MIT

CONFIG_ADC_NRFX_SAADC=y

# Enable MPU
CONFIG_ARM_MPU=y

# Use pinctrl
CONFIG_PINCTRL=y

# enable GPIO
CONFIG_GPIO=y

CONFIG_USE_DT_CODE_PARTITION=y
CONFIG_BUILD_OUTPUT_UF2=y

CONFIG_MPU_ALLOW_FLASH_WRITE=y
CONFIG_NVS=y
CONFIG_SETTINGS_NVS=y
CONFIG_FLASH=y
CONFIG_FLASH_PAGE_LAYOUT=y
CONFIG_FLASH_MAP=y
CONFIG_CLOCK_CONTROL_NRF=y
CONFIG_CLOCK_CONTROL_NRF_K32SRC_RC=y

CONFIG_ZMK_SPLIT=y

CONFIG_ZMK_BLE=y

# never output usb
CONFIG_ZMK_USB=n

CONFIG_INPUT=y

# RGB
#CONFIG_SPI=n
#CONFIG_ZMK_EXT_POWER=n

CONFIG_EC11=y
CONFIG_EC11_TRIGGER_GLOBAL_THREAD=y

# Lower the slave latency the split peripheral asks the central to allow.
# ZMK's default (app/Kconfig) is BT_PERIPHERAL_PREF_LATENCY=30 with a
# preferred conn interval of 7.5–15 ms. That lets the peripheral skip up
# to ~465 ms of conn events for power savings, and produces the "right
# key arrives after a quickly-following left key" reorder we see at high
# typing speed (#7). 5 caps the worst-case skip near ~90 ms while still
# leaving meaningful idle-time radio off; revisit if user testing wants
# 0 (lowest latency, ~+25% half-current) or 10 (closer to default).
CONFIG_BT_PERIPHERAL_PREF_LATENCY=5

# vim: set ft=kconfig:
```

## config/west.yml
```yaml
manifest:
  remotes:
    - name: zmkfirmware
      url-base: https://github.com/zmkfirmware
    - name: hitsmaxft
      url-base: https://github.com/hitsmaxft
    - name: englmaxi
      url-base: https://github.com/englmaxi
    - name: urob
      url-base: https://github.com/urob
    - name: janpfischer
      url-base: https://github.com/janpfischer
  projects:
    - name: zmk
      remote: zmkfirmware
      revision: main
      clone-depth: 1
      import:
        file: app/west.yml
    - name: zmk-helpers
      remote: urob
      revision: main
      clone-depth: 1
    # zmk-rgbled-widget intentionally not included.
    # - hitsmaxft fork has a typeless `config WS2812_STRIP` (Kconfig:29) that
    #   collides with Zephyr's bool of the same name and breaks every build
    #   (including settings_reset) the moment it is on west.
    # - caksoylar upstream is GPIO-leds only and refuses to build without
    #   `led-red/green/blue` aliases pointing at a `gpio-leds` node, which
    #   Cornix does not have (WS2812 over SPI3 instead).
    # The RGB indicator will be implemented as a self-built out-of-tree module
    # driving led_strip directly. See issue #2 stage B.
    - name: zmk-dongle-display
      remote: englmaxi
      revision: main
      clone-depth: 1
    #- name: zmk-dongle-screen
    #  remote: janpfischer
    #  revision: main
    #  clone-depth: 1
  self:
    path: config
```
